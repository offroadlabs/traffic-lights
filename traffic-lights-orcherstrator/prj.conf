## CMakeLists.txt
```
cmake_minimum_required(VERSION 3.20.0)

set(CONF_FILE "prj.conf")
set(BOARD qemu_x86)

enable_language(C CXX)

set(CMAKE_CXX_STANDARD 17)
set(CMAKE_CXX_STANDARD_REQUIRED ON)
set(CMAKE_CXX_EXTENSIONS OFF)

find_package(Zephyr REQUIRED HINTS $ENV{ZEPHYR_BASE})
project(traffic-lights-orcherstrator)

target_compile_options(app PRIVATE $<$<COMPILE_LANGUAGE:CXX>:-fno-exceptions>)
target_compile_options(app PRIVATE $<$<COMPILE_LANGUAGE:CXX>:-fno-rtti>)
target_compile_options(app PRIVATE $<$<COMPILE_LANGUAGE:CXX>:-fno-threadsafe-statics>)

target_sources(app PRIVATE 
    src/main.cpp
    src/logger.cpp
    src/http_client.cpp
)

target_include_directories(app PRIVATE
    ${CMAKE_CURRENT_SOURCE_DIR}/src
)
```

## prj.conf
```kconfig
CONFIG_CPP=y
CONFIG_STD_CPP17=y
CONFIG_REQUIRES_FULL_LIBC=y
CONFIG_NEWLIB_LIBC=y

CONFIG_MAIN_STACK_SIZE=3072
CONFIG_SYSTEM_WORKQUEUE_STACK_SIZE=2048

CONFIG_NETWORKING=y
CONFIG_NET_IPV4=y
CONFIG_NET_IPV6=y
CONFIG_NET_TCP=y
CONFIG_NET_SHELL=y

CONFIG_NET_SOCKETS=y
CONFIG_ZVFS_POLL_MAX=4
CONFIG_POSIX_API=y

CONFIG_TEST_RANDOM_GENERATOR=y

CONFIG_NET_PKT_RX_COUNT=16
CONFIG_NET_PKT_TX_COUNT=16
CONFIG_NET_BUF_RX_COUNT=128
CONFIG_NET_BUF_TX_COUNT=128
CONFIG_NET_CONTEXT_NET_PKT_POOL=y

CONFIG_NET_CONFIG_SETTINGS=y
CONFIG_NET_CONFIG_NEED_IPV4=y
CONFIG_NET_CONFIG_NEED_IPV6=y
CONFIG_NET_CONFIG_MY_IPV4_ADDR="192.0.2.1"
CONFIG_NET_CONFIG_MY_IPV4_GW="192.0.2.2"
CONFIG_NET_CONFIG_PEER_IPV4_ADDR="192.0.2.2"
CONFIG_NET_CONFIG_MY_IPV6_ADDR="2001:db8::1"
CONFIG_NET_CONFIG_PEER_IPV6_ADDR="2001:db8::2"

CONFIG_HTTP_CLIENT=y

CONFIG_LOG=y
CONFIG_NET_LOG=y
CONFIG_NET_SOCKETS_LOG_LEVEL_DBG=n
CONFIG_NET_HTTP_LOG_LEVEL_DBG=n
CONFIG_NET_IPV6_LOG_LEVEL_DBG=n
CONFIG_NET_IPV6_ND_LOG_LEVEL_DBG=n

CONFIG_LOG_MODE_DEFERRED=y
CONFIG_LOG_DEFAULT_LEVEL=3
CONFIG_LOG_RUNTIME_FILTERING=y
CONFIG_LOG_BUFFER_SIZE=2048
```

## src/main.cpp
```c
#include "main.hpp"
#include "logger.h"
#include "http_client.hpp"
#include <zephyr/kernel.h>
#include <string.h>

K_MSGQ_DEFINE(state_change_queue, sizeof(StateChangeEvent), 10, 4);
K_THREAD_STACK_DEFINE(http_stack, HTTP_STACK_SIZE);
struct k_thread http_thread_data;
k_tid_t http_thread_id;

TrafficLight lights[4] = {
    {"North", LightState::RED},
    {"South", LightState::RED},
    {"East", LightState::RED},
    {"West", LightState::RED}};

// Timer callback
void timer_expiry_callback(struct k_timer *timer)
{
    auto *light = CONTAINER_OF(timer, TrafficLight, timer);
    StateChangeEvent evt;
    evt.light_index = light - &lights[0];
    evt.new_state = LightState::RED;
    k_msgq_put(&state_change_queue, &evt, K_NO_WAIT);
}

// Thread HTTP
void http_thread_entry(void *, void *, void *)
{
    HttpClient client;
    StateChangeEvent evt;

    while (1)
    {
        if (k_msgq_get(&state_change_queue, &evt, K_FOREVER) == 0)
        {
            auto &light = lights[evt.light_index];
            light.state = evt.new_state;

            // Envoi asynchrone de l'état
            client.send_traffic_light_state(
                light.name,
                state_to_string(light.state));

            log_light_state(light.name,
                            state_to_string(light.state));
        }
    }
}

void change_axis_state(int light1_index, int light2_index, LightState new_state, uint32_t duration_ms)
{
    StateChangeEvent evt1 = {light1_index, new_state};
    StateChangeEvent evt2 = {light2_index, new_state};

    k_msgq_put(&state_change_queue, &evt1, K_NO_WAIT);
    k_msgq_put(&state_change_queue, &evt2, K_NO_WAIT);

    if (duration_ms > 0)
    {
        k_timer_start(&lights[light1_index].timer, K_MSEC(duration_ms), K_NO_WAIT);
        k_timer_start(&lights[light2_index].timer, K_MSEC(duration_ms), K_NO_WAIT);
    }
}

void init_traffic_system()
{
    for (auto &light : lights)
    {
        k_timer_init(&light.timer, timer_expiry_callback, nullptr);
    }

    http_thread_id = k_thread_create(&http_thread_data, http_stack,
                                     K_THREAD_STACK_SIZEOF(http_stack),
                                     http_thread_entry,
                                     NULL, NULL, NULL,
                                     5, 0, K_NO_WAIT);
    k_thread_name_set(http_thread_id, "http_thread");
}

const char *state_to_string(LightState state)
{
    switch (state)
    {
    case LightState::RED:
        return "red";
    case LightState::YELLOW:
        return "yellow";
    case LightState::GREEN:
        return "green";
    default:
        return "unknown";
    }
}

void intersection_cycle()
{
    // Nord-Sud passage au vert
    log_cycle_start("North-South");
    change_axis_state(0, 1, LightState::GREEN, TIME_GREEN);
    k_sleep(K_MSEC(TIME_GREEN));

    change_axis_state(0, 1, LightState::YELLOW, TIME_YELLOW);
    k_sleep(K_MSEC(TIME_YELLOW));

    change_axis_state(0, 1, LightState::RED, TIME_SAFETY);
    k_sleep(K_MSEC(TIME_SAFETY));

    // Est-Ouest passage au vert
    log_cycle_start("East-West");
    change_axis_state(2, 3, LightState::GREEN, TIME_GREEN);
    k_sleep(K_MSEC(TIME_GREEN));

    change_axis_state(2, 3, LightState::YELLOW, TIME_YELLOW);
    k_sleep(K_MSEC(TIME_YELLOW));

    change_axis_state(2, 3, LightState::RED, TIME_SAFETY);
    k_sleep(K_MSEC(TIME_SAFETY));
}

int main()
{
    init_traffic_system();

    while (1)
    {
        intersection_cycle();
    }
    return 0;
}
```

## src/http_client.cpp
```c
#include "http_client.hpp"
#include <zephyr/logging/log.h>
#include <string.h>
#include <stdio.h>

LOG_MODULE_REGISTER(http_client, LOG_LEVEL_INF);

#define HTTP_PORT 8000
#define SERVER_ADDR CONFIG_NET_CONFIG_PEER_IPV4_ADDR
#define MAX_RECV_BUF_LEN 512

HttpClient::HttpClient() {}
HttpClient::~HttpClient() {}

static uint8_t recv_buf[MAX_RECV_BUF_LEN];

void HttpClient::response_callback(struct http_response *rsp,
                                   enum http_final_call final_data,
                                   void *user_data)
{
    if (final_data == HTTP_DATA_MORE)
    {
        LOG_INF("Données partielles reçues (%zd bytes)", rsp->data_len);
        LOG_INF("Contenu: %.*s", rsp->data_len, (char *)rsp->recv_buf);
    }
    else if (final_data == HTTP_DATA_FINAL)
    {
        LOG_INF("Toutes les données reçues (%zd bytes)", rsp->data_len);
        LOG_INF("Contenu final: %.*s", rsp->data_len, (char *)rsp->recv_buf);
    }

    LOG_INF("Statut de la réponse: %d %s",
            rsp->http_status_code,
            rsp->http_status);
}

int HttpClient::setup_connection()
{
    struct sockaddr_in addr;
    int sock;

    sock = socket(AF_INET, SOCK_STREAM, IPPROTO_TCP);
    if (sock < 0)
    {
        LOG_ERR("Échec de la création du socket (%d)", -errno);
        return -errno;
    }

    memset(&addr, 0, sizeof(addr));
    addr.sin_family = AF_INET;
    addr.sin_port = htons(HTTP_PORT);
    inet_pton(AF_INET, SERVER_ADDR, &addr.sin_addr);

    int ret = connect(sock, (struct sockaddr *)&addr, sizeof(addr));
    if (ret < 0)
    {
        LOG_ERR("Échec de la connexion au serveur (%d)", -errno);
        close(sock);
        return -errno;
    }

    return sock;
}

void HttpClient::send_traffic_light_state(const char *id, const char *state)
{
    int sock;
    int32_t timeout = 3 * MSEC_PER_SEC;
    char payload[128];
    char content_len[64];

    // Création du payload JSON
    snprintf(payload, sizeof(payload), "{\"id\":\"%s\",\"state\":\"%s\"}", id, state);
    snprintf(content_len, sizeof(content_len), "Content-Length: %d\r\n", strlen(payload));

    // Configuration de la connexion
    sock = setup_connection();
    if (sock < 0)
    {
        LOG_ERR("Échec de la configuration de la connexion");
        return;
    }

    // Préparation de la requête HTTP
    struct http_request req;
    memset(&req, 0, sizeof(req));

    const char *headers[] = {
        "Content-Type: application/json\r\n",
        content_len,
        NULL};

    req.method = HTTP_POST;
    req.url = "/traffic-light";
    req.host = SERVER_ADDR;
    req.protocol = "HTTP/1.1";
    req.header_fields = headers;
    req.payload = payload;
    req.payload_len = strlen(payload);
    req.response = response_callback;
    req.recv_buf = recv_buf;
    req.recv_buf_len = sizeof(recv_buf);

    // Envoi de la requête
    LOG_INF("Envoi de l'état du feu tricolore %s: %s", id, state);
    LOG_INF("Payload: %s", payload);

    int ret = http_client_req(sock, &req, timeout, NULL);
    if (ret < 0)
    {
        LOG_ERR("Échec de l'envoi de l'état du feu tricolore (err: %d)", ret);
    }

    // Fermeture de la connexion
    close(sock);
}
```

## src/http_client.hpp
```c
#ifndef HTTP_CLIENT_HPP
#define HTTP_CLIENT_HPP

#include <zephyr/kernel.h>
#include <zephyr/net/socket.h>
#include <zephyr/net/http/client.h>

class HttpClient
{
public:
    HttpClient();
    ~HttpClient();

    void send_traffic_light_state(const char *id, const char *state);

private:
    int setup_connection();
    static void response_callback(struct http_response *rsp,
                                  enum http_final_call final_data,
                                  void *user_data);
};

#endif
```

## src/logger.cpp
```c
#include "logger.h"
#include <zephyr/logging/log.h>

LOG_MODULE_REGISTER(traffic_lights, LOG_LEVEL_INF);

void log_light_state(const char *name, const char *state)
{
    LOG_INF("Feu tricolore %s: %s", name, state);
}

void log_cycle_start(const char *axis)
{
    LOG_INF("Début du cycle %s", axis);
}
```

## src/logger.h
```c
#ifndef LOGGER_H
#define LOGGER_H

#include <zephyr/kernel.h>

void log_light_state(const char *light_name, const char *state);
void log_system_start(uint32_t green_time, uint32_t yellow_time, uint32_t safety_time);
void log_cycle_start(const char *axis);

#endif
```

## src/main.hpp
```c
#ifndef MAIN_HPP
#define MAIN_HPP

#include <zephyr/kernel.h>
#include <zephyr/net/socket.h>
#include <zephyr/net/http/client.h>

enum class LightState
{
    RED,
    YELLOW,
    GREEN
};

struct TrafficLight
{
    const char *name;
    LightState state;
    k_timer timer;
};

struct StateChangeEvent
{
    int light_index;
    LightState new_state;
};

extern struct k_msgq state_change_queue;
extern struct k_thread http_thread_data;
extern k_tid_t http_thread_id;

constexpr uint32_t TIME_GREEN = 30000;
constexpr uint32_t TIME_YELLOW = 5000;
constexpr uint32_t TIME_SAFETY = 5000;

constexpr size_t HTTP_STACK_SIZE = 2048;

void init_traffic_system();
void http_thread_entry(void *, void *, void *);
const char *state_to_string(LightState state);

#endif
```
